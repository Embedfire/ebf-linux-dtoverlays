/*
 * Copyright (C) 2019 - All Rights Reserved by 
 * filename : imx-fire-ecspi3-overlay.dts
 * brief : Device Tree overlay for EBF6ull ecspi3' device
 * author : embedfire
 * date : 2019-12-10 
 * version : A001
 */
#include "imx6ul-pinfunc.h"
#include "imx6ull-pinfunc-snvs.h"
#include "dt-bindings/interrupt-controller/irq.h"
#include "dt-bindings/gpio/gpio.h"
/dts-v1/;
/plugin/;

/ {
		fragment@0 {
			target = <&ecspi3>;
			__overlay__ {
				#address-cells = <1>;
	   	  #size-cells = <0>; 
				spidev@0 {
					compatible = "spidev";
					spi-max-frequency = <20000000>;
					reg = <0>;
				};
			};
		};
};
