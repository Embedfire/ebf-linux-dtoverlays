/*
 * Copyright (C) 2019 - All Rights Reserved by 
 * filename : imx-fire-enet2-overlay.dts
 * brief : Device Tree overlay for EBF6ull enet2 device
 * author : embedfire
 * date : 2020-02-17 
 * version : A001
 */
#include "imx6ul-pinfunc.h"
#include "imx6ull-pinfunc-snvs.h"
#include "dt-bindings/interrupt-controller/irq.h"
#include "dt-bindings/gpio/gpio.h"

/dts-v1/;
/plugin/;

/ {
		fragment@0 {
			target = <&aips1>;
			__overlay__ {
				fec2: ethernet@20b4000 {
				status = "okay";
				};
			};
		};

	__overrides__ {
		enable = <&fec2>,"status";
	};
};
