/*
 * Copyright (C) 2019 - All Rights Reserved by 
 * filename : imx-fire-gpmi-overlay.dts
 * brief : Device Tree overlay for EBF6ull nand flash device
 * author : embedfire
 * date : 2020-02-17 
 * version : A001
 */
#include "imx6ul-pinfunc.h"
#include "imx6ull-pinfunc-snvs.h"
#include "dt-bindings/interrupt-controller/irq.h"
#include "dt-bindings/gpio/gpio.h"

/dts-v1/;
/plugin/;

/ {
		fragment@0 {
			target = <&aips2>;
			__overlay__ {
				gpmi: gpmi-nand@1806000 {
					status = "okay";
					#address-cells = <1>;
					#size-cells = <1>;

					partition_uboot: partition@0 {
							label = "uboot";
							reg = <0x00000000 0x00800000>;
						};
					partition_rootfs: partition@1 {
							label = "rootfs";
							reg = <0x00800000 0x1F800000>;
						};
				};
			};
		};

	__overrides__ {
		enable = <&gpmi>,"status";
		uboot_size = <&partition_uboot>,"reg:4",<&partition_rootfs>,"reg:0";
		rootfs_size = <&partition_rootfs>,"reg:4";
	};
};
