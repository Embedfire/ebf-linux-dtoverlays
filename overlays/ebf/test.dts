/*
 * Copyright (C) 2019 - All Rights Reserved by 
 * filename : imx-fire-key-overlay.dts
 * brief : Device Tree overlay for EBF6ull key device
 * author : embedfire
 * date : 2019-12-10
 * version : A001
 */
#include "imx6ul-pinfunc.h"
#include "imx6ull-pinfunc-snvs.h"
#include "dt-bindings/input/linux-event-codes.h"
#include "dt-bindings/gpio/gpio.h"

/dts-v1/;
/plugin/;

/{
	
	fragment@0 {
		target-path = "/";
		__overlay__ {
			my_test {
					compatible = "my-test-node";
					pinctrl-names = "default";
					reg = <0x80000000 0x20000000>;

			};			
		};
	};
	
};
