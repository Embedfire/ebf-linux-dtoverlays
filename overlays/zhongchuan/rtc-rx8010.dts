

/dts-v1/;
/plugin/;
#include "imx6ul-pinfunc.h"
#include "dt-bindings/gpio/gpio.h"

 / {
    fragment@0 {
        target= <&i2c2>;
         __overlay__{	
            rx8010: rx8010@32 {
                compatible = "epson,rx8010";
                reg = <0x32>;
                status = "okay";
            };
        };
    };

 };