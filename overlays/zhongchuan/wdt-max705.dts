/*
 * Copyright (C) 2019 - All Rights Reserved by 
 * filename : wdt-max705.dts
 * brief : 
 * author : embedfire
 * date : 2019-12-14 
 * version : A001
 */
/dts-v1/;
/plugin/;
#include "imx6ul-pinfunc.h"
#include "dt-bindings/gpio/gpio.h"
#include "imx6ull-pinfunc-snvs.h"


/ {
	fragment@0 {
		target-path = "/";
		__overlay__ {
			wdt_max705 {
				compatible = "linux,wdt-gpio";
				gpios = <&gpio5 4 GPIO_ACTIVE_LOW>;
				hw_algo = "toggle";
				always-running;
				hw_margin_ms = <1600>;				
			};
		
		};
	};


	fragment@1 {
		target = <&iomuxc_snvs>;
		__overlay__ {
			pinctrl_max705: max705 {
				fsl,pins = <				
					MX6UL_PAD_SNVS_TAMPER4__GPIO5_IO04          0x010b0
				>;
			};					
		};
	};

};
